## components/swarm_hal/Kconfig
```kconfig
menu "My Robot Dimensions"

    config K_WHEEL_RADIUS_MM
        int "Wheel radius (mm)"
        range 1 500
        default 33

    config K_HALF_TRACK_MM
        int "Half track, center to wheel (mm)"
        range 1 1000
        default 75

endmenu
```

## components/swarm_ros/Kconfig
```kconfig
menu "Swarm ROS"

    config SWARM_ROS_NAMESPACE
        string "ROS namespace for this board"
        default "swarm_1"
        help
            Namespace the node and its relative topics live under, e.g. a
            value of "swarm_1" gives /swarm_1/base and /swarm_1/cmd_vel.
            Must be a valid ROS identifier: [A-Za-z_][A-Za-z0-9_]*. Each
            board in the swarm needs a distinct value, or the nodes collide
            on the agent. Empty puts the node at the root.

endmenu
```

## main/Kconfig.projbuild
```kconfig
menu "My Application Settings"

  config K_INITIATOR
    bool "Ultrawide band test initiator"
    default n

endmenu

menu "My Robot Dimensions"

    config K_WHEEL_RADIUS_MM
        int "Wheel radius (mm)"
        range 1 500
        default 33

    config K_HALF_TRACK_MM
        int "Half track, center to wheel (mm)"
        range 1 1000
        default 75

endmenu
```
